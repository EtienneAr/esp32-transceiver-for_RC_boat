## receiver/components/motorControl/Kconfig.projbuild
```kconfig
menu "Motor_Control"
	
	config MOTORCONTROL_PIN
        int "Pin"
        default 12
        range 1 34
        help
            The pin that will be used to control the main motor.

    config MOTORCONTROL_PERIOD_US
        int "PWM period (us)"
        default 20000
        help
            Period of the pwm to send to the motor driver.

    config MOTORCONTROL_WIDTH_MAX_US
        int "PWM max width (us). Correspond to max speed."
        default 2000
        help
            Maximum width (in us) for the pwn to be high.

    config MOTORCONTROL_WIDTH_MID_US
        int "PWM mid width (us). Correspond to 0 speed."
        default 1500
        help
            Mid width (in us) to output 0 speed.

    config MOTORCONTROL_WIDTH_MIN_US
        int "PWM min width (us). Correspond to max reversed speed."
        default 1000
        help
            Minimum width (in us) for the pwn to be high.

endmenu
```

## receiver/components/servoControl/Kconfig.projbuild
```kconfig
menu "Servo_Control"
	
	config SERVOCONTROL_PIN
        int "Pin"
        default 14
        range 1 34
        help
            The pin that will be used to control the main motor.

    config SERVOCONTROL_PERIOD_US
        int "PWM period (us)"
        default 20000
        help
            Period of the pwm to send to the motor driver.

    config SERVOCONTROL_WIDTH_MAX_US
        int "PWM max width (us). Correspond to max position."
        default 2000
        help
            Maximum width (in us) for the pwn to be high.

    config SERVOCONTROL_WIDTH_MIN_US
        int "PWM min width (us). Correspond to max reversed position."
        default 1000
        help
            Minimum width (in us) for the pwn to be low.

endmenu
```

## transmitter/components/inputs/Kconfig.projbuild
```kconfig
menu "Inputs"
	
	config JOY_A_PIN
        int "Joystick A analog Pin"
        default 34
        range 34 34
        help
            The pin that will be used for stick A analog input.

    config JOY_B_PIN
        int "Joystick B analog Pin"
        default 35
        range 35 35
        help
            The pin that will be used for stick B analog input.

    config BUTTON_A_PIN
        int "Joystick A click Pin"
        default 3
        range 1 34
        help
            The pin that will be used for button A (joystick click).

    config BUTTON_B_PIN
        int "Joystick B click Pin"
        default 21
        range 1 34
        help
            The pin that will be used for utton B (joystick click).

    config POT_A_PIN
        int "Potentiometer A pin"
        default 32
        range 32 32
        help
            The pin that will be used for potentiometer A analog input.

    config POT_B_PIN
        int "Potentiometer A pin"
        default 33
        range 33 33
        help
            The pin that will be used for potentiometer B analog input.

endmenu
```

## transmitter/components/led_strip/Kconfig.projbuild
```kconfig
menu "Leds"
	
	config LEDS_PIN
        int "Pin"
        default 12
        range 1 34
        help
            The pin that will be used for driving the ws2812b leds.

endmenu
```

## transmitter/components/sticks/Kconfig.projbuild
```kconfig
menu "Sticks"
	
	config STICKS_A_PIN
        int "Pin"
        default 34
        range 34 34
        help
            The pin that will be used for stick A analog input.

    config STICKS_B_PIN
        int "Pin"
        default 35
        range 35 35
        help
            The pin that will be used for stick B analog input.

    config POT_A_PIN
        int "Pin"
        default 32
        range 32 32
        help
            The pin that will be used for potentiometer A analog input.

    config STICKS_B_PIN
        int "Pin"
        default 33
        range 33 33
        help
            The pin that will be used for potentiometer B analog input.

endmenu
```
